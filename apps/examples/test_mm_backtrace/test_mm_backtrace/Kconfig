## apps/examples/test_mm_backtrace/test_mm_backtrace/Kconfig
```kconfig
#
# For a description of the syntax of this configuration file,
# see kconfig-language at https://www.kernel.org/doc/Documentation/kbuild/kconfig-language.txt
#

config EXAMPLES_MM_BACKTRACE
	bool "MM backtrace leak detection example"
	default n
	depends on DEBUG_MM_HEAPINFO
	---help---
		Allocates memory intentionally without freeing to demonstrate
		CONFIG_MM_BACKTRACE leak detection and call-site backtrace.
		Requires CONFIG_DEBUG_MM_HEAPINFO for alloc_call_addr recording.
		With CONFIG_MM_BACKTRACE > 0 (NuttX port), shows full backtrace.

config USER_ENTRYPOINT
	string
	default "test_mm_backtrace_main" if ENTRY_TEST_MM_BACKTRACE
```

## apps/examples/test_mm_schedbt/test_mm_schedbt/Kconfig
```kconfig
#
# For a description of the syntax of this configuration file,
# see kconfig-language at https://www.kernel.org/doc/Documentation/kbuild/kconfig-language.txt
#

config EXAMPLES_MM_SCHEDBT
	bool "MM leak detection example (sched_backtrace / EHABI)"
	default n
	depends on DEBUG_MM_HEAPINFO && SCHED_BACKTRACE
	---help---
		Same intentional-leak scenario as test_mm_backtrace, but uses the
		precise sched_backtrace() engine (CONFIG_SCHED_BACKTRACE), which
		walks the compiler-generated EHABI unwind tables (.ARM.exidx) via
		libgcc's _Unwind_Backtrace instead of the heuristic stack scan.
		Requires CONFIG_DEBUG_MM_HEAPINFO and CONFIG_SCHED_BACKTRACE.

config USER_ENTRYPOINT
	string
	default "test_mm_schedbt_main" if ENTRY_TEST_MM_SCHEDBT
```

## apps/system/test_memory_info/test_memory_info/Kconfig
```kconfig
#
# For a description of the syntax of this configuration file,
# see kconfig-language at https://www.kernel.org/doc/Documentation/kbuild/kconfig-language.txt
#

config SYSTEM_TEST_MEMORY_INFO
	bool "Test Memory Info tool"
	default n
	depends on DEBUG_MM_HEAPINFO
	---help---
		Enable the test_memory_info shell command. It provides heapinfo-like
		heap inspection and, with the -t option, dumps each task's live
		allocations together with the allocation backtrace (captured via
		sched_backtrace()) on a single line. The -t option additionally
		requires CONFIG_MM_BACKTRACE > 0.
```
